//*******************************************免责声明*******************************************//
/*无锡矽杰微电子有限公司（简称：无锡矽杰微）保留关于该历程可靠性、功能和设计方面的改进作进一步说明的权利。
由于使用本历程中的信息或内容而导致的直接，间接，特别附带结果的损害，无锡矽杰微没有义务负责。
本历程中代码的应用仅仅是用来做功能演示，本公司不保证这些代码没有更深入的测试就能适用。
本历程中使用的软件，都是依据授权或保密合约所合法提供的，并且只能在这些合约的许可条件下使用或者复制。
无锡矽杰微的产品不是专门设计来应用于生命维持的用具，装置或者系统。
无锡矽杰微的产品不支持而且禁止在这些方面的应用。
本历程内容如有变动恕不另作通知，具体更新信息，请参考公司官方网站www.xjmcu.com。*/
//===================================================================================//
//主频：8M/4T
//功能介绍：
//P65输出adc内置基准电压
//P64输出vdd电压
//===================================================================================//

//==============================================================================
//头文件	运用头文件	通用寄存器定义文件
//==============================================================================
			include "XC8P8600.ash"
			include "Regdefine.H"
//==============================================================================
//入口地址	程序入口地址	中断入口地址
//==============================================================================
			org     	0x00
         	jmp	 		Fili_Init				//	程序入口地址
				       
         	org     	0x08
         	jmp     	Intcall_TCC				//	中断入口地址
;==============================================================================
;中断函数
;==============================================================================
Intcall_TCC:
        	MOV		    A_BUFF,A				
			SWAP		A_BUFF					
			SWAPA	    R3
			MOV		    R3_BUFF,A				//	中断入栈保护
			clr         isr                  	//	1ms定时时间到
			mov         a,@TCC_NUM           	//	定时器赋初值 
			add         TCC,a 					//	
			bts			BitTCCEnable			//	1ms set	 							 
Init_TCC1:       
       	 	SWAPA	    R3_BUFF
			MOV		    R3,A
			SWAPA	    A_BUFF					//	中断出栈保护恢复
        	reti 
        	
   		   		   

;==============================================================================
;初始化函数
;============================================================================== 		
Fili_Init:  	
			di									//	close all eni
     		clra								//	a = 0
     		ctw									//	cont = a 控制寄存器 _ INT TS TE PAB PSR2 PSR1 PSR0 		
;==============================================================================
;清通用寄存器
;==============================================================================    		
			FiliCLRRAM							//	clear ram			
;==============================================================================
;GPIO口配置函数
;============================================================================== 
			mov        	a,@0x00				
     		mov        	port6,a				
			mov        	a,@0x01					//	P63 = in;	P65.P64.P61.P62 = out；P60作为ADC检测口
     		iw        	ioc6				
			mov        	a,@0x00					
     		mov        	port6,a				
     		
     		mov        	a,@0xff					//	下拉关
     		iw        	iocb 				
     		mov        	a,@0xff				
     		iw        	iocd 					//	上拉关
;==============================================================================
;TCC时钟配置
;==============================================================================      		
     		MOV		   	A,@TCC_1_8				//	设置TCC预分频1:8
			ctw
			MOV		   	A,@0X10						
			iw		   	IOCE					//p65为输出基准电压口，禁狗
			MOV		   	A,@0X01              	//	开启TCC中断    
			iw		   	IOCF					//	
			mov        	a,@TCC_NUM           	//	初值为6
			mov        	TCC,a					//	定时中断设置T = （256-6）*（1/4MHz）*2Clock*8 = 1ms 	
			clr        	isr		            	//	清中断标志位	
;==============================================================================
;ADC初始化设置
;0x07	-	ADC控制寄存器
;0x07	-	ADC通道&基准电压&分频选择(IOPAGE)
;============================================================================== 
			mov			a,@0b00000000
			mov			ADCON,a					//	0x07
			mov			a,@0b00000010			//	时钟选择Fosc/16	通道P60	基准电压3V
			iw			ADCVS					//	
			mov			a,@0b00010000			//	ADC0作为模拟口输入
			iw			ADPS					//
			btc			VFOE					//	(控制位用于启用Vref Out)	
			bts			ADPD					//	使能adc

			ei                            		//	开总中断              			
;			jmp			main					//	进入主函数
;==============================================================================
;主函数
;==============================================================================  
main:		
			jbts		BitTCCEnable			
			jmp			$-1						
			btc			BitTCCEnable			//	1ms come on	
			bts			IOLED1					//输出adc内置基准电压
			bts			IOLED2					//输出vdd电压
			jmp			main				



