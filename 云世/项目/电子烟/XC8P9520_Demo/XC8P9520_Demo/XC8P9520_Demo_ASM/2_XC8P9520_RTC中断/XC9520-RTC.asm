//*******************************************免责声明*******************************************//
/*无锡矽杰微电子有限公司（简称：无锡矽杰微）保留关于该例程可靠性、功能和设计方面的改进作进一步说明的权利。
由于使用本例程中的信息或内容而导致的直接，间接，特别附带结果的损害，无锡矽杰微没有义务负责。
本例程中代码的应用仅仅是用来做功能演示，本公司不保证这些代码没有更深入的测试就能适用。
本例程中使用的软件，都是依据授权或保密合约所合法提供的，并且只能在这些合约的许可条件下使用或者复制。
无锡矽杰微的产品不是专门设计来应用于生命维持的用具，装置或者系统。无锡矽杰微的产品不支持而且禁止在这些方面的应用。
本例程内容如有变动恕不另作通知，具体更新信息，请参考公司官方网站www.xjmcu.com。*/
//===================================================================================//
//主频：8M/4T 
;RTC-DEMO功能说明：
;使用TRC功能时，在选项中使能RTC功能；
;硬件会把TCC分配给RTC计数，TCC按照外部晶振跑，主程序按照IRC跑(例如：8MHz/4Clock)
;TCC中断，初值设定等都被RTC占用
;该例程:
;设置RTC定时1秒,P60取反 
//===================================================================================//
//==============================================================================
//头文件	运用头文件	通用寄存器定义文件
//==============================================================================
		include "XC8P9520.ASH"
		include "XJ_Define.h"
//==============================================================================
//入口地址	程序入口地址	中断入口地址
//==============================================================================
		org		0x00
		jmp		file_start			//程序入口地址
		org		0x08			
		jmp		file_Interrupt		//中断入口地址
;==============================================================================
;中断函数
;==============================================================================
file_Interrupt:
		mov		A_BUFF,A
		swap	A_BUFF
		swapa	R3
		mov		R3_BUFF,A		//中断入栈保护

		di 
		jbts	TCIF 
		jmp		file_Interrupt_ret
;---------TCC定时中断------------
;RTC-tcc定时中断1s,P60取反
file_intTCC:	
		mov		a,@0x0e				//ISR的bit0:TCIF清零
		mov		isr,a

		mov		a,@0x01				;P60口输出取反		 
		xor		port6,a				
	//	mov     a,@data_tcc			;定时器赋初值 
	//	add		tcc,a 				;
	//	jmp		file_Interrupt_ret	; 
file_Interrupt_ret:
		swapa	R3_BUFF
		mov		R3,A
		swapa	A_BUFF				//中断出栈保护恢复
		reti 
;==============================================================================
;初始化函数
;==============================================================================		
file_init:
		mov		   	A,@0x84			;设置TCC预分频1:32,bit7:RTCS使能
		ctw							;bit7=1:选择外部晶振时钟（LXT 的 4 分频）
		clr			tcc				;定时中断设置T = (1/32.768KHz)*4Clock*32*256 = 1S 
		clr		port6	 
		mov		a,@0x0				;P6口方向寄存器
		iw		ioc6				;1:输入，0:输出  
		mov		a,@0xff				;bit4~bit6对应P60~P62	
		iw		iocb				;下拉寄存器，0使能
		mov		a,@0xff				;bit0~bit7对应P60~P67
		iw		iocd				;上拉寄存器，0使能
		mov		a,@0x00				;bit7，看门狗使能位，1使能
		iw		ioce				;bit6，P60功能控制位，0:普通IO口。1:外部中断口
		mov		a,@0x01				;中断屏蔽寄存器，1使能Tcc中断
		iw		iocf				;bit0对应TCC中断，bit1对应输入电平变化中断，bit2对应外部中断			
		clr		isr					;中断标志寄存器
		ret	
;==============================================================================
; 初始化程序 
;==============================================================================  
file_start: 
    	M9520CLRRAMBANK				;上电复位,清RAM
     	call	file_init			;控制寄存器初始化
     	jmp		main  

;==============================================================================
;主函数
;============================================================================== 
main:
		ei						;开总中断  
		cwdt    
		jmp		main			;进入主函数  







