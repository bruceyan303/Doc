//*******************************************免责声明*******************************************//
/*无锡矽杰微电子有限公司（简称：无锡矽杰微）保留关于该例程可靠性、功能和设计方面的改进作进一步说明的权利。
由于使用本例程中的信息或内容而导致的直接，间接，特别附带结果的损害，无锡矽杰微没有义务负责。
本例程中代码的应用仅仅是用来做功能演示，本公司不保证这些代码没有更深入的测试就能适用。
本例程中使用的软件，都是依据授权或保密合约所合法提供的，并且只能在这些合约的许可条件下使用或者复制。
无锡矽杰微的产品不是专门设计来应用于生命维持的用具，装置或者系统。无锡矽杰微的产品不支持而且禁止在这些方面的应用。
本例程内容如有变动恕不另作通知，具体更新信息，请参考公司官方网站www.xjmcu.com。*/
//===================================================================================//
//主频：8M/4T
//PWM-DEMO功能说明： 
//Tcc中断1ms,P64端口取反
//pwm中断100us,P65端口取反
//pwm时钟选择Fcpu
//pwm1-P62	20%占空比，周期100us (PWM1是否取反根据需要调用)
//pwm2-P61	40%占空比，周期100us
//pwm3-P60	80%占空比，周期100us                       
//===================================================================================//
//==============================================================================//
//头文件	运用头文件	通用寄存器定义文件
//==============================================================================//
#include "XC8P9520.h"
#include "XJ_9520Define.h"
//===================================//
//void file_clrRam(void);
//void file_init(void);
//void file_project_init(void);
//===================================//
//初始化RAM:10H~3FH
//===================================//
void file_clrRam()
{
	for(RSR=0x90;RSR<0xFF;RSR++)	//清零 BANK0 RAM  IAR-R0,RSR-R4

	{IAR = 0;}
	 IAR = 0;
}
//===================================//
//端口初始化
//===================================//
void file_init(void)
{	
	CONTW(0x02);			//TCC 8分频
	TCC = 6;				//1/2 * 8 * (256-6) = 1000us	公式：1/IRC频率 * 预分频 * （256-初值）
	PORT6 = 0;				//P6口输出低
	IOCP_W(P6CR,0x08);		//P6口设为输出
	IOCP_W(PHDCR,0xff);		//端口上下拉控制寄存器，bit7-bit4对应P67-P64下拉;bit3-bit0对应P53-P50上拉 
	IOCP_W(PDCR,0xff);		//端口下拉控制寄存器，  bit6-bit4对应P62-P60,bit3-bit0对应P53-P50
	IOCP_W(PHCR,0xff);		//P6端口上拉控制寄存器  bit7-bit0对应P67-P60
	IOCP_W(WDTCR,0x00);		//WDT 使能控制寄存器
	IOCP_W(IMR,0x01);		//中断使能控制寄存器 
	ISR = 0x0;				//清TC0中断标志位 
}
//===================================//
//TC0初始化
//===================================//
void file_project_init(void)
{	
//---------------------------------
//PWM设置，3路pwm是共周期的
//---------------------------------
//file_pwm_set:   
	IOCP_W(IMR,0x09);		//TCC+PWM周期中断,根据需要调用	
	PWMCON = 0xf8;			//使能3路pwm输出，pwm=1/8*2(分频)*4clock*100=100us
	PRD = 100;				//PWM周期寄存器
	PDC1 = 20;				//pwm1占空比
	PDC2 = 40;				//pwm2占空比
	PDC3 = 80;				//pwm3占空比
}
//===================================//
//中断服务程序
//===================================//
void int_isr(void) __interrupt 
{    	
	__asm__("org 0x08");			//中断入口地址			
	PUSH(_A_BUFF,_R3_BUFF);			//中断入栈保护
//=========Tcc中断程序===============//
	if(TCIF == 1)					//判断TCIF是否为1
	{
		TCC	  += 6;			//1/2 * 8 * (256-6) = 1000us	公式：1/IRC频率 * 预分频 * （256-初值）
		ISR    = 0xfe;				//清TC0中断标志位
	 PORT6_4 = !PORT6_4;			//P64口翻转
	}	 
//======== PWM周期中断程序===============//
	if(T1IF == 1)					//判断T1IF是否为1,pwm周期中断
	{	 
		ISR    = 0xf7;				//ISR的bit3:T1IF清零
		PORT6_5 = !PORT6_5;			//P65口翻转
	}

	POP(_A_BUFF,_R3_BUFF);			//中断出栈保护恢复
}

//===================================//
//MAIN主程序
//===================================//
void main()
{
	file_clrRam();					//清RAM
	file_init();					//io寄存器初始化
	file_project_init();			//程序所需功能设置
	EI();							//打开总中断
	while(1)
	{
	//	PORT6_1 = !PORT6_1;	
		NOP();
		NOP();
		NOP();
	}
}