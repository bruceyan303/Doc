//*******************************************免责声明*******************************************//
/*无锡矽杰微电子有限公司（简称：无锡矽杰微）保留关于该历程可靠性、功能和设计方面的改进作进一步说明的权利。
由于使用本历程中的信息或内容而导致的直接，间接，特别附带结果的损害，无锡矽杰微没有义务负责。
本历程中代码的应用仅仅是用来做功能演示，本公司不保证这些代码没有更深入的测试就能适用。
本历程中使用的软件，都是依据授权或保密合约所合法提供的，并且只能在这些合约的许可条件下使用或者复制。
无锡矽杰微的产品不是专门设计来应用于生命维持的用具，装置或者系统。
无锡矽杰微的产品不支持而且禁止在这些方面的应用。
本历程内容如有变动恕不另作通知，具体更新信息，请参考公司官方网站www.xjmcu.com。*/
//===================================================================================//
//主频：8M/4T
//功能介绍：
//P65口输出adc内置基准电压
//P64输出vdd电压
//===================================================================================//

//==============================================================================
//头文件	运用头文件	IOC页寄存器定义文件
//==============================================================================
#include "XC8P8600.H"
#include "LE8600.H"
#define EI()    __asm__(" ei ")
#define DI()    __asm__(" di ")
#define NOP()   __asm__(" nop ")
#define CWDT()  __asm__(" CWDT ")
#define	SLEEP()	__asm__(" sleep ")
#define CONTW(VAL)			__asm__("mov a,@"#VAL"\n ctw")			//CTW = VAL：CONT寄存器赋值
#define IOCP_W(REG,VAL)		__asm__("mov a,@"#VAL"\n iw "#REG)		//REG = VAL：IOC页寄存器赋值
#define IOCP_R(RAM,REG)		__asm__("ir "#REG"\n mov "#RAM",a")		//RAM = REG：IOC页寄存器读值

void CLR_RAM();
void IO_Init(void);
void TCC_Init(void);
//===================================//
//初始化RAM:10H~4FH
//===================================//
void CLR_RAM()
{
	for(RSR=0x90;RSR<0xCF;RSR++)	//清零 BANK0 RAM
	{IAR=0;}
	IAR	= 0;
}

//===================================//
//端口初始化
//===================================//
void IO_Init(void)
{
	PORT6 = 0x00;					//P6口输出低
	IOCP_W(P6CR,0x00);				//P6口设为输出
	IOCP_W(PDCR,0XFF);				//下拉关闭
	IOCP_W(PHCR,0XFF);				//上拉关闭
}

//===================================//
//TC0初始化
//===================================//
void TCC_Init(void)
{		
	CONTW(0x02);					//TCC 8分频
	IOCP_W(WDTCR,0X10);				//P65输出基准电压使能
	TCC = 0x06;						//1/2 * 8 * (256-6) = 1000us	公式：1/IRC频率 * 预分频 * （256-初值）
	ISR = 0xfe;						//清TC0中断标志位
	IOCP_W(IMR,0x01);				//使能TCC
}


//===================================//
//ADC初始化
//===================================//
void ADC_Init(void)
{		
	IOCP_W(ADPS,0x10);				//AD0设置为模拟输入口
	IOCP_W(ADCVS,0x02);				//ADC时钟：Fosc/16; ADC通道：AD0(P60); 内部基准电压：3V
	//IOCP_W(WDTCR,0X00);
	ADCON = 0x40;					//ADC使能
}

//===================================//
//MAIN主程序
//===================================//
void main()
{
	CLR_RAM();
	BitADCEnable=0;
	RegADCDang=0;
	IO_Init();
	TCC_Init();
	ADC_Init();
	EI();										//打开总中断
	while(1)
	{
		NOP();	
		PORT6_5 = 1; //adc内置基准电压
		PORT6_4= 1;	 //vdd电压
		//AD_CAIJI();	
	//	led_out();
	//	FileOutWorkLED();
								
		
	}
}

//===================================//
//中断服务程序
//===================================//
void int_isr(void) __interrupt 
{    	
	__asm__("org 0x08");
	PUSH(_A_BUFF,_R3_BUFF);			//中断入栈保护

	if(TCIF)					//判断TCIF是否为1
	{
		ISR = 0x00;					//清TC0中断标志位
		TCC += 0x06;				//1/2 * 8 * (256-6) = 1000us	公式：1/IRC频率 * 预分频 * （256-初值）		
		BitTCCEnable=1;
	}
		
	POP(_A_BUFF,_R3_BUFF);			//中断出栈保护恢复
}















