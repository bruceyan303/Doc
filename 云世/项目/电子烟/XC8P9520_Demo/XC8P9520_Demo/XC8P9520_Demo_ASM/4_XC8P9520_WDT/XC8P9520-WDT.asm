//*******************************************免责声明*******************************************//
/*无锡矽杰微电子有限公司（简称：无锡矽杰微）保留关于该例程可靠性、功能和设计方面的改进作进一步说明的权利。
由于使用本例程中的信息或内容而导致的直接，间接，特别附带结果的损害，无锡矽杰微没有义务负责。
本例程中代码的应用仅仅是用来做功能演示，本公司不保证这些代码没有更深入的测试就能适用。
本例程中使用的软件，都是依据授权或保密合约所合法提供的，并且只能在这些合约的许可条件下使用或者复制。
无锡矽杰微的产品不是专门设计来应用于生命维持的用具，装置或者系统。无锡矽杰微的产品不支持而且禁止在这些方面的应用。
本例程内容如有变动恕不另作通知，具体更新信息，请参考公司官方网站www.xjmcu.com。*/
//===================================================================================//
//主频：8M/4T 
;WDT复位唤醒-DEMO功能说明：
;CONT的bit3(PAB)=1，IOCE的bit7(WDTEN)=1
;WDT定时(时间受电压影响)睡眠，唤醒后led工作1us
;WDT定时时间=WDT唤醒时间*2分频(WDT)*计数(此程序为10次)
;5.0V,WDT唤醒时间18.2ms,Sleep:394ms+work1us,功耗5.0uA 
;4.5V,WDT唤醒时间22.0ms,Sleep:440ms+work1us,功耗3.9uA; 
;4.0V,WDT唤醒时间25.0ms,Sleep:501ms+work1us,功耗3.0uA; 
;3.5V,WDT唤醒时间29.3ms,Sleep:586ms+work1us,功耗2.1-2.2uA;
;3.0V,WDT唤醒时间35.4ms,Sleep:708.7ms+work1us,功耗1.5-1.6uA;
;如果使能 WDT 唤醒，建议客户禁止其他唤醒。
//===================================================================================//
//==============================================================================
//头文件	运用头文件	通用寄存器定义文件
//==============================================================================
		include "XC8P9520.ASH"
		include "XJ_Define.h"
//==============================================================================
//入口地址	程序入口地址	中断入口地址
//==============================================================================
		org		0x00
start:
		jbtc	t
       	jmp		file_powerReset_start ;上电复位程序入口地址
		jmp		file_wdtReset_start	  ;WDT复位 
;================================================
;睡眠计时子程序
;================================================ 	
file_WDTTime:
		inc		reg_timeSleep 	 
		mov		A,@10;23;10 			 
		sub		A,reg_timeSleep 
		jbts	c				 
		jmp		file_WDTTime_ret		 
		clr		reg_timeSleep 
	 
		bts		io_ledOut	
		nop
		nop 
		call	delay_10ms
		btc		io_ledOut 
file_WDTTime_ret:
		ret
;================================================
;睡眠子程序
;================================================ 			
file_WDTWake_slep:
;-----------------------------------------			
		mov		a,@0x00		 ;如果分频是由TCC切换而来，需要先关WDT
		iw		ioce
;-----------------------------------------					
		mov		a,@0x00
		iw		iocf
		clr		IMR
		cwdt
		mov		a,@0x09		 ;预分频分给wdt,1分频 
		ctw	
		cwdt
		clr		IMR
		mov		a,@0x80		 ;开WDT
		iw		ioce
		di
		nop
		sleep
		nop
		jmp		start 
;==============================================================================
;初始化函数
;==============================================================================		
file_init:
		mov		a,@data_tcc
		mov		tcc,a
		mov		a,@data_contw		;预分频器分配给TCC，bit5为0时P62才能做普通IO口
		ctw							;分频比为1:8
		clr		port6	 
		mov		a,@0x0				;P6口方向寄存器
		iw		ioc6				;1:输入，0:输出  
		mov		a,@0xff				;bit4~bit6对应P60~P62	
		iw		iocb				;下拉寄存器，0使能
		mov		a,@0xff				;bit0~bit7对应P60~P67
		iw		iocd				;上拉寄存器，0使能
		mov		a,@0x00				;bit7，看门狗使能位，1使能
		iw		ioce				;bit6，P60功能控制位，0:普通IO口。1:外部中断口
		mov		a,@0x01				;中断屏蔽寄存器，1使能Tcc中断
		iw		iocf				;bit0对应TCC中断，bit1对应输入电平变化中断，bit2对应外部中断			
		clr		isr					;中断标志寄存器
		ret	 
;============延时10ms============
delay_10ms:
   		mov 	a,@1       ;改此处可改变延时时间
   		mov		delay_a,a 
cc:
   		mov  	a,@33
   		mov  	delay_b,a
bb:
		mov 	a,@196
		mov  	delay_c,a
aa:
		dj  	delay_c
		jmp 	aa     
		dj 		delay_b
		jmp 	bb
		dj	 	delay_a
		jmp 	cc
		ret 	
;==============================================================================
; 初始化程序 
;==============================================================================  
file_powerReset_start: 
    	M9520CLRRAMBANK				;上电复位,清RAM
file_wdtReset_start:
     	call	file_init			;控制寄存器初始化 
     	jmp		main  

;==============================================================================
;主函数
;============================================================================== 
main:	
	;	ei							;开总中断  
		;	cwdt   
		call	file_WDTTime		;WDT定时
		call	file_WDTWake_slep	;WDT唤醒睡眠	
		jmp		main				;进入主函数  







