//*******************************************免责声明*******************************************//
/*无锡矽杰微电子有限公司（简称：无锡矽杰微）保留关于该例程可靠性、功能和设计方面的改进作进一步说明的权利。
由于使用本例程中的信息或内容而导致的直接，间接，特别附带结果的损害，无锡矽杰微没有义务负责。
本例程中代码的应用仅仅是用来做功能演示，本公司不保证这些代码没有更深入的测试就能适用。
本例程中使用的软件，都是依据授权或保密合约所合法提供的，并且只能在这些合约的许可条件下使用或者复制。
无锡矽杰微的产品不是专门设计来应用于生命维持的用具，装置或者系统。无锡矽杰微的产品不支持而且禁止在这些方面的应用。
本例程内容如有变动恕不另作通知，具体更新信息，请参考公司官方网站www.xjmcu.com。*/
//===================================================================================//
//主频：8M/4T
//PWM-DEMO功能说明： 
//Tcc中断1ms,P64端口取反
//pwm中断100us,P65端口取反
//pwm时钟选择Fcpu
//pwm1-P62	20%占空比，周期100us (PWM1是否取反根据需要调用)
//pwm2-P61	40%占空比，周期100us
//pwm3-P60	80%占空比，周期100us
//===================================================================================//
//==============================================================================
//头文件	运用头文件	通用寄存器定义文件
//==============================================================================
		include "XC8P9520.ASH"
		include "XJ_Define.h"
//==============================================================================
//入口地址	程序入口地址	中断入口地址
//==============================================================================
		org		0x00
		jmp		file_start			//程序入口地址
		org		0x08			
		jmp		file_Interrupt		//中断入口地址
;==============================================================================
;中断函数
;==============================================================================
file_Interrupt:
		mov		A_BUFF,A
		swap	A_BUFF
		swapa	R3
		mov		R3_BUFF,A		//中断入栈保护
		
		di
		jbtc	T1IF			
		jmp		file_intPWM
		jbts	TCIF
		jmp		file_Interrupt_ret
;---------TCC定时中断------------
file_intTCC:	
		mov		a,@0x0e			//ISR的bit0:TCIF清零
		mov		isr,a

		mov		a,@0x10				;P64口输出取反		 
		xor		port6,a				
		mov     a,@data_tcc			;定时器赋初值 
		add		tcc,a 				;
		jmp		file_Interrupt_ret	; 
;---------PWM周期中断------------			
file_intPWM:
		mov		a,@0x07				;ISR的bit3:T1IF清零
		mov		isr,a 
									
		mov		a,@0x20
		xor		port6,a				;P65口输出取反 
file_Interrupt_ret:
		swapa	R3_BUFF
		mov		R3,A
		swapa	A_BUFF				//中断出栈保护恢复
		reti 
;==============================================================================
;初始化函数
;==============================================================================		
file_init:
		mov		a,@data_tcc
		mov		tcc,a
		mov		a,@data_contw		;预分频器分配给TCC，bit5为0时P62才能做普通IO口
		ctw							;分频比为1:8
		clr		port6	 
		mov		a,@0x0				;P6口方向寄存器
		iw		ioc6				;1:输入，0:输出  
		mov		a,@0xff				;bit4~bit6对应P60~P62	
		iw		iocb				;下拉寄存器，0使能
		mov		a,@0xff				;bit0~bit7对应P60~P67
		iw		iocd				;上拉寄存器，0使能
		mov		a,@0x00				;bit7，看门狗使能位，1使能
		iw		ioce				;bit6，P60功能控制位，0:普通IO口。1:外部中断口
		mov		a,@0x01				;中断屏蔽寄存器，1使能Tcc中断
		add		a,@0x08				//;使能T1中断，根据需要选择
		iw		iocf				;bit0对应TCC中断，bit1对应输入电平变化中断，bit2对应外部中断			
		clr		isr					;中断标志寄存器
		ret	 
;==============================================================================
;PWM123配置函数  
;PWM 周期 = PRD * T1 预分频 * TPWMCKS
;PWM 占空比 = PDC * T1 预分频 * TPWMCKS
;注：TPWMCKS 可以通过 RE 寄存器的 bit6 选择配置为:系统时钟 Fcpu(PWMCKS=0)或震荡时钟 Fosc(PWMCKS=1)		
;============================================================================== 
file_pwmSet:
		mov		a,@0b11111000   ;pwm=1/8*2(分频)*4clock*100=100us	 
		mov		PWMCON,a		//pwm计数器，pwm1/2/3使能
		mov		a,@100
		mov		PRD,A			//PWM周期
		mov		a,@20
		mov		PDC1,a			//pwm1占空比
		mov		a,@40
		mov		PDC2,a			//pwm2占空比
		mov		a,@80			
		mov		PDC3,a			//pwm3占空比

		;PWM1取反输出，常用来跟pwm2或pwm3互补输出用 
		//mov			a,@0b10000000
		//mov			RE,A				;PWM1互补输出
		ret 
;==============================================================================
; 初始化程序 
;==============================================================================  
file_start: 
    	M9520CLRRAMBANK				;上电复位,清RAM
     	call	file_init			;控制寄存器初始化
     	call	file_pwmSet			;其他初始化
     	jmp		main  

;==============================================================================
;主函数
;============================================================================== 
main:
		ei						;开总中断  
		cwdt    
		jmp		main			;进入主函数  







